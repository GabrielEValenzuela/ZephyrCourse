## CMakeLists.txt
```
# Use Zephyr's build system
cmake_minimum_required(VERSION 3.20.0)

find_package(Zephyr REQUIRED HINTS $ENV{ZEPHYR_BASE})
project(zephyrCourse)
set(CMAKE_CXX_STANDARD 20)

# Add application source files
target_sources(app PRIVATE src/main.cpp)

# Include specific modules
zephyr_include_directories(modules/cmsis)
zephyr_include_directories(modules/hal_nordic)
```

## prj.conf
```kconfig
# Add Zephyr configuration settings
CONFIG_CPP=y
```

## src/main.cpp
```c
#include <zephyr.h>
#include <sys/printk.h>

void check_board() {
#ifdef CONFIG_BOARD
    printk("CONFIG_BOARD is set to your host board.\n");
#else
    printk("CONFIG_BOARD does not correspond to your host board.\n");
#endif
}

void main() {
    printk("Zephyr Application with Star Topology\n");
    check_board();
}
```
